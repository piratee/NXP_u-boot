## board/freescale/mx6ull_para_evk/Kconfig
```kconfig
if TARGET_MX6ULL_14X14_EVK || TARGET_MX6ULL_PARA_EVK

config SYS_BOARD
	default "mx6ull_para_evk"

config SYS_VENDOR
	default "freescale"

config SYS_CONFIG_NAME
	default "mx6ull_para_evk"

config IMX_CONFIG
	default "board/freescale/mx6ull_para_evk/imximage.cfg"

config TEXT_BASE
	default 0x87800000
endif
```
